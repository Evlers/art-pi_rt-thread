## Kconfig
```kconfig
mainmenu "RT-Thread Configuration"

config BSP_DIR
    string
    option env="BSP_ROOT"
    default "."

config RTT_DIR
    string
    option env="RTT_ROOT"
    default "rt-thread"

config PKGS_DIR
    string
    option env="PKGS_ROOT"
    default "packages"

config OFFLINE_PKGS_DIR
    string
    default "offline-packages"

source "$RTT_DIR/Kconfig"
source "$PKGS_DIR/Kconfig"
source "$OFFLINE_PKGS_DIR/Kconfig"
source "$RTT_DIR/../libraries/Kconfig"
source "$RTT_DIR/../board/Kconfig"

config RT_STUDIO_BUILT_IN
    bool
    select ARCH_ARM_CORTEX_M7
    select RT_USING_COMPONENTS_INIT
    select RT_USING_USER_MAIN
    default y
```

## libraries/Kconfig
```kconfig
menu "External Libraries"

    source "$RTT_DIR/../libraries/wifi-host-driver/Kconfig"

endmenu
```

## offline-packages/Kconfig
```kconfig
menu "RT-Thread offline packages"

source "offline-packages/iot/Kconfig"
source "offline-packages/security/Kconfig"
source "offline-packages/language/Kconfig"
source "offline-packages/tools/Kconfig"
source "offline-packages/misc/Kconfig"

endmenu
```

## offline-packages/iot/Kconfig
```kconfig
menu "IoT - internet of things"

source "offline-packages/iot/pahomqtt/Kconfig"
source "offline-packages/iot/webclient/Kconfig"
source "offline-packages/iot/nopoll/Kconfig"
source "offline-packages/iot/netutils/Kconfig"

endmenu
```

## offline-packages/language/JSON/Kconfig
```kconfig
menu "JSON: JavaScript Object Notation, a lightweight data-interchange format"

source "offline-packages/language/JSON/cJSON/Kconfig"

endmenu
```

## offline-packages/language/Kconfig
```kconfig
menu "language packages"

source "offline-packages/language/JSON/Kconfig"

endmenu
```

## offline-packages/misc/Kconfig
```kconfig
menu "miscellaneous packages"

source "offline-packages/misc/optparse/Kconfig"

endmenu
```

## offline-packages/security/Kconfig
```kconfig
menu "security packages"

source "offline-packages/security/mbedtls/Kconfig"
source "offline-packages/security/tinycrypt/Kconfig"

endmenu
```

## offline-packages/tools/Kconfig
```kconfig
menu "tools packages"

source "offline-packages/tools/easyflash/Kconfig"
source "offline-packages/tools/cpu_usage/Kconfig"

endmenu
```

## offline-packages/tools/cpu_usage/Kconfig
```kconfig
# Kconfig file for package cpu_usage
menuconfig PKG_USING_CPU_USAGE
    bool "CPUU: CPU usage statistics tool."
    default n
```
